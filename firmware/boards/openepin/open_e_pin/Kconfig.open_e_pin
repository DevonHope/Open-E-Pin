## firmware/boards/openepin/open_e_pin/Kconfig.open_e_pin
```kconfig
# SPDX-License-Identifier: GPL-3.0-or-later

config BOARD_OPEN_E_PIN
	select SOC_NRF52840_QIAA
```

## firmware/boards/openepin/open_e_pin/board.yml
```yaml
board:
  name: open_e_pin
  full_name: Open E-Pin
  vendor: openepin
  socs:
    - name: nrf52840
```
